## drivers/usb_c/ppc/Kconfig
```kconfig
# Power path controllers configuration options

# Copyright 2023 The Chromium OS Authors
# SPDX-License-Identifier: Apache-2.0

menuconfig USBC_PPC_DRIVER
	bool "USB-C PPC drivers"
	help
	  Enable Power Path Controllers drivers

if USBC_PPC_DRIVER

config USBC_PPC_INIT_PRIORITY
	int "USBC PPC driver init priority"
	default 82
	help
	  USB-C device driver initialization priority.
	  Do not mess with it unless you know what you are doing.
	  Note that the priority needs to be lower than the USBC stack
	  so that it can start before the USBC sub-system.

config USBC_PPC_SHELL
	bool "Shell commands for PPC"
	default n
	help
	  Adds useful shell commands to manipulate and debug the PPCs

module = USBC_PPC
module-str = usbc-ppc
source "subsys/logging/Kconfig.template.log_config"

endif # USBC_PPC_DRIVER
```

## drivers/usb_c/ppc/Kconfig.nxp
```kconfig
# USB-C STM32 TCPC device configuration options

# Copyright 2022 The Chromium OS Authors
# SPDX-License-Identifier: Apache-2.0

config USBC_PPC_NX20P348X
	bool "USB-C TCPC device controller driver"
	default y
	depends on DT_HAS_NXP_NX20P348X_ENABLED
	help
	  Enable USB-C PPC support for nxp nx20p348x family
```

## drivers/usb_c/tcpc/Kconfig.tcpc_tcpci
```kconfig
# USB-C Parade PS8xxx TCPC device configuration options

# Copyright (c) 2023 The Chromium OS Authors
# SPDX-License-Identifier: Apache-2.0

config USBC_TCPC_TCPCI
	bool
	help
	  Enable support for Type-C Port Controller Interface

if USBC_TCPC_TCPCI

config USBC_TCPC_TCPCI_I2C_RETRIES
	int "I2C communication retries"
	default 2
	help
	  Number of I2C transaction tries that will be performed for each request.
	  Some TCPCs are going into deep sleep mode when no charger is connected and won't respond
	  to the i2c address immediately. If device won't respond after retries, it means that
	  it is not responsible or is not connected.

config USBC_TCPC_TCPCI_TRANSMIT_RETRIES
	int "Data transmit retries"
	default 2
	range 0 3
	depends on USBC_TCPC_TCPCI
	help
	  Maximum number of packet retransmissions done by TCPC

config USBC_TCPC_TCPCI_SHELL
	bool "Shell commands for TCPCI"
	default n
	help
	  Enable support for TCPCI shell commands

endif

config USBC_TCPC_PS8XXX
	bool "USB-C TCPC device controller driver"
	select USBC_TCPC_TCPCI
	default y
	depends on DT_HAS_PARADE_PS8XXX_ENABLED
	help
	  Enable USB-C TCPC support for the Parade PS8xxx chip family

if USBC_TCPC_PS8XXX

config USBC_TCPC_PS8XXX_INIT_DELAY
	int "PS8xxx init delay"
	default 25
	help
	  Delay between each try of TCPC initialization

config USBC_TCPC_PS8XXX_INIT_RETRIES
	int "PS8xxx init retries"
	default 10
	help
	  Number of initialization tries that will be performed

endif
```

## drivers/usb_c/vbus/Kconfig.usbc_vbus_tcpci
```kconfig
# USB-C VBUS device configuration options

# Copyright 2023 The Chromium OS Authors
# SPDX-License-Identifier: Apache-2.0

config USBC_VBUS_TCPCI
	bool "USB-C VBUS TCPCI"
	select USBC_TCPC_TCPCI
	default y
	depends on DT_HAS_ZEPHYR_USB_C_VBUS_TCPCI_ENABLED
	help
	  Measure VBUS using the TCPC chip compliance to TCPCI

config USBC_VBUS_INIT_PRIORITY
	int "USB-C VBUS driver init priority"
	default 81
```

## dts/bindings/i2c/zephyr,i2c-dump-filter.yaml
```yaml
# Copyright 2023 The Chromium OS Authors
# SPDX-License-Identifier: Apache-2.0

description: Filter for i2c messages dump

compatible: "zephyr,i2c-dump-filter"

include: base.yaml

properties:
  status:
    const: "okay"

  devices:
    required: true
    type: phandles
```

## dts/bindings/ppc/nxp,nx20p348x.yaml
```yaml
# Copyright 2023 The Chromium OS Authors
# SPDX-License-Identifier: Apache-2.0

description: NXP NX20P348x Power path controllers family

compatible: "nxp,nx20p348x"

include: [base.yaml, i2c-device.yaml]

properties:
  irq-gpios:
    type: phandle-array
    description: interrupt pin
```

## dts/bindings/tcpc/parade,ps8xxx.yaml
```yaml
# Copyright 2023 The Chromium OS Authors
# SPDX-License-Identifier: Apache-2.0

description: |
    Parade PS8xxx series TCPC chip

compatible: "parade,ps8xxx"

include: [base.yaml, pinctrl-device.yaml]

properties:
  reg:
    required: true
```

## dts/bindings/usb-c/zephyr,usb-c-vbus-tcpci.yaml
```yaml
# Copyright 2023 The Chromium OS Authors
# SPDX-License-Identifier: Apache-2.0

description: |
    This device is used to measure VBUS on a Type-C Port and to
    discharge VBUS when needed.

compatible: "zephyr,usb-c-vbus-tcpci"

include: [base.yaml]
```
